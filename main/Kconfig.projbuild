## main/Kconfig.projbuild
```kconfig
menu "Example Configuration"

    config BROKER_URL
        string "Broker URL"
        default "mqtt://mqtt.eclipseprojects.io"
        help
            URL of the broker to connect to

    config BROKER_URL_FROM_STDIN
        bool
        default y if BROKER_URL = "FROM_STDIN"
        
    config REED_SWITCH_1
 		 int "Reed switch №1 GPIO number"
 		 range 0 48
 		 default 4
 		 help
      		GPIO number reed switch 1.

    config REED_SWITCH_2
 		 int "Reed switch №2 GPIO number"
 		 range 0 48
 		 default 5
 		 help
      		GPIO number reed switch 2.
      		
endmenu
```
